//generated by ChatGPT, edited by Isabella Phung for UCSC CSE121 Spring Lab 5
#include <wiringPi.h>
#include <stdio.h>
#include <string.h>

//define GPIO pin
#define dot_length 30 //length of dot in ms
#define dash_length dot_length*3
#define LED_PIN 0 //GPIO 17 on Raspi
#define repeat 4 //how many times to repeat the message

/*
//debug versions
void dot(){
    printf(".");
}

void dash(){
    printf("-");
}

void letterSpace(){
    printf(" ");
}

void wordSpace(){
    printf("  ");
}
*/

//LED versions
void dot(){
    digitalWrite(LED_PIN, HIGH);
    delay(dot_length);
    digitalWrite(LED_PIN, LOW);
    delay(dot_length);
}

void dash(){
    digitalWrite(LED_PIN, HIGH);
    delay(dash_length);
    digitalWrite(LED_PIN, LOW);
    delay(dot_length);
}

void letterSpace(){
    digitalWrite(LED_PIN, LOW);
    delay(dot_length*2);
}

void wordSpace(){
    digitalWrite(LED_PIN, LOW);
    delay(dot_length*2);
}

char toUpper(char character){
    const int diff = 'a' - 'A';
    //printf("%c\n",character);
    if(character <= 'z' && character >= 'a'){
        character -= diff;
    }
    //printf("%c\n",character);
    return character;
}

void textToMorse(char* text){
    const char* numbers[] = {"11111", "01111", "00111", "00011", "00001", "00000", "10000", "11000", "11100", "11110", NULL, NULL, NULL, NULL, NULL, NULL, NULL, "01", "1000", "1010", "100", "0", "0010", "110", "0000", "00", "0111", "101", "0100", "11", "10", "111", "0110", "1101", "010", "000", "1", "001", "0001", "011", "1001", "1011", "1100"}; //space is 32,  48 to 57 for numbers, then 65 to 90 for the letters
    char ch;
    int index;
    char* textcpy = text;
    char* codeptr;
    while(*textcpy){
        ch = toUpper(*textcpy);
        if(ch == ' '){
            wordSpace();            
        }else{
            index = ch - 48;
            codeptr = numbers[index];
            while(*codeptr){
                if(*codeptr == '0'){
                    dot();
                }else{
                    dash();
                }
                codeptr++;
            }
        }
        letterSpace();
        textcpy++;
    }
}


int main(int argc, char **argv){
    if(argc != 2){
        printf("Please enter a message!");
        return 1;
    }
    //Setup WiringPi and configure pin
    if(wiringPiSetup() == -1){
        printf("WiringPi setup failed!\n");
        return 1;
    }

    pinMode(LED_PIN, OUTPUT);
    
    char* text = argv[1]; 
    for(int i = 0; i < repeat; i++){
        textToMorse(text);
        letterSpace();
        letterSpace();
        letterSpace();
        //printf("i: %d\n", i);
    }
    return 0;
}
